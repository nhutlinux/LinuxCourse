## 11-Linux-Device-Driver/01-bcm2835-gpio-legacy-driver/Kconfig
```kconfig
menu "mgpio device driver"

config MGPIO
	tristate "mgpio device driver"
	depends on ARM
	default y if ARM
	help
	   Select this option to run mgpio module.
endmenu
```

## 11-Linux-Device-Driver/03-bcm2835-gpio-descriptor-base-driver/Kconfig
```kconfig
menu "DevLinux: Module GPIO Device Driver"

config MGPIO
        tristate
        prompt "DevLinux: Module GPIO Device Driver"
        depends on ARM || ARM64
        default m if ARM || ARM64
        help
           Select this option to run mgpio module.
endmenu
```

## 11-Linux-Device-Driver/04-i2c-driver/01-ssd1306-driver/Kconfig
```kconfig
menu "DevLinux: SSD1306 I2C Device Driver"

config MSSD1306
        tristate
        prompt "DevLinux: SSD1306 I2C Device Driver"
        depends on ARM || ARM64
        default m if ARM || ARM64
        help
           Select this option to run ssd1306 module.
endmenu
```

## 11-Linux-Device-Driver/05-spi-driver/01-ssd1306-driver/Kconfig
```kconfig
menu "DevLinux: SSD1306 Spi Device Driver"

config MLCD
        tristate
        prompt "DevLinux: SSD1306 SPI Device Driver"
        depends on ARM || ARM64
        default m if ARM || ARM64
        help
           Select this option to run ssd1306 module.
endmenu
```
